/*
 * ============================================================================
 *music.c —— 【早期版本，当前工程未引用】
 * ============================================================================
 *
 *  【重要说明】
 *  本文件是项目早期的试验版本，Keil 工程 atm89.uvproj 中并未引用本文件
 *  （工程当前仅引用 MusicBox_Keil_Project\main.c）。
 *  完整的最终实现见 main.c，本文件仅作开发过程留档。
 *
 *  【早期版本与最终版的功能差异】
 *      本文件实现：蜂鸣器播放单首简单旋律（音高表 tone + 音符表 song1）
 *      main.c 实现：定时器中断驱动音高、点阵显示曲目号、LED 指示音高、
 *                  三首曲目、单曲/列表循环切换、完整按键消抖
 *
 *  【演进原因】
 *  早期版本用"软件延时 + 阻塞式播放"驱动蜂鸣器（见本文件 beep 函数），
 *  存在两个根本问题：
 *    1) 音高依赖循环次数，受编译器优化影响，同一段代码重编译后音调可能变化；
 *    2) 播放期间 CPU 全部占用，无法同时响应按键与显示刷新。
 *  因此最终版改为：定时器0 中断翻转引脚产生方波（音高），
 *  定时器1 中断累减计时（时值），主循环只负责调度与按键扫描。
 *
 *  ============================================================================
 */

#include <REGX52.H>
#include "delay.h"

/* ===========================================================================
 *  早期版本全局变量
 * =========================================================================*/

/* 当前曲目编号，由 key.c 的按键扫描模块修改 */
unsigned char song_id = 0;

/* 蜂鸣器引脚 */
sbit BEEP = P1^0;

/*
 * 音高频率表（单位：Hz）
 * 下标对应音名：C4 D4 E4 F4 G4 A4 B4 C5
 * 本表采用"频率直接存储"的方式，由软件延时换算翻转次数，
 * 因此精度受编译器优化影响 —— 这也是最终版改用定时器的原因。
 */
unsigned int code tone[] = {
    0,     /* 0 表示休止符，不发声 */
    262,   /* C4 */
    294,   /* D4 */
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    494,   /* B4 */
    523    /* C5 */
};

/* 旋律音符表：下标对应 tone[]，数值表示音高序号 */
unsigned char code song1[] = {
    1,1,5,5,6,6,5,    /* 两只老虎的前半句 */
    4,4,3,3,2,2,1     /* 后半句 */
};

/* 当前播放到第几个音符 */
unsigned char idx = 0;

/* ===========================================================================
 *  beep —— 驱动蜂鸣器发出指定频率的声音
 * ===========================================================================
 *
 *  实现原理（早期方案，最终版已废弃）：
 *    通过内层空循环延时 duration = 500/f 个计数的时间，
 *    使引脚翻转，形成近似方波。
 *
 *  参数 f —— 目标频率（Hz），传入 tone[] 中的值；传入 0 时表示休止
 *
 *  【此实现的问题】
 *    1) 频率由软件延时决定，精度完全依赖编译器优化策略与指令周期数，
 *       更换编译器版本或优化等级后音调可能明显变化；
 *    2) 函数全程阻塞，无法在发声期间处理按键、显示等任务；
 *    3) 外层循环固定 120 次，音量控制无从下手。
 *
 *  最终版 main.c 的做法见 t0_isr()：用定时器硬件计数产生方波，
 *  频率由重装载值精确决定，且 ISR 只做"翻转 + 重装载"两件事，
 *  不影响主循环的响应能力。
 */
void beep(unsigned int f)
{
    unsigned int i, j;

    if(f == 0) {
        /* 休止符：仅延时一个音符时长，不翻转引脚 */
        DelayMs(150);
        return;
    }

    for(i = 0; i < 120; i++)            /* 外层控制音量/包络（粗略模拟） */
    {
        for(j = 0; j < 500/f; j++);    /* 内层空循环产生延时 */
        BEEP = ~BEEP;                  /* 翻转输出，形成方波 */
    }
}

/* ===========================================================================
 *  Play_Music —— 播放下一个音符
 * ===========================================================================
 *
 *  推进音符下标，循环播放 song1。
 *  由主循环反复调用，每次调用播放一个音符。
 */
void Play_Music(void)
{
    beep(tone[song1[idx]]);   /* 按当前音符表项查频率并发声 */
    idx++;

    /*
     * 边界检查 —— 已在早期修订中修正为元素个数计算。
     *
     * 【原代码 Bug】
     *     if(idx >= sizeof(song1)) idx = 0;
     * sizeof(song1) 返回的是数组占用的"字节数"，而非"元素个数"。
     * 本例中数组恰好有 14 个 unsigned char 元素，故 sizeof 也等于 14，
     * 表面上未出错；但这是典型的"侥幸正确"，一旦数组类型改变
     * （如改为 unsigned int）或增删元素，就会发生数组越界访问，
     * 行为不可预知。
     *
     * 【正确写法】
     *     if(idx >= sizeof(song1) / sizeof(song1[0])) idx = 0;
     * 用 sizeof(数组) / sizeof(首元素) 得到元素个数，
     * 该写法与元素类型、元素个数均无关，是通用安全写法。
     */
    if(idx >= sizeof(song1) / sizeof(song1[0])) {
        idx = 0;
    }
}